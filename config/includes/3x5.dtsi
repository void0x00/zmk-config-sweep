#include <behaviors.dtsi>
#include <dt-bindings/zmk/keys.h>
#include <dt-bindings/zmk/bt.h>
// #include <dt-bindings/zmk/outputs.h>
// #include <dt-bindings/zmk/rgb.h>
// #include <dt-bindings/zmk/ext_power.h>
#include <behaviors/rgbled_widget.dtsi>

// Layer aliases
#define DEF 0
#define NUM 1
#define SYM 2
#define NAV 3
#define MSE 4

// totem 4 row additional keys
#define L_EXP ESC
#define R_EXP RET

#include "shortcut.dtsi"
#include "combos.dtsi"
#include "mouse.dtsi"
#include "behaviors.dtsi"
#include "macros.dtsi"

/* Nav cluster */

// Trigger tap-action on all interrupts.
#define MT_CORE                                                                \
  flavor = "tap-preferred";                                                    \
  tapping-term-ms = <220>;                                                     \
  quick-tap-ms = <220>;                                                        \
  hold-trigger-key-positions = <0>;

&mt { MT_CORE };

ZMK_HOLD_TAP(mt_home, bindings = <&masked_home>, <&kp>; MT_CORE)
ZMK_HOLD_TAP(mt_end, bindings = <&masked_end>, <&kp>; MT_CORE)

#define NAV_LEFT  &mt_home 0   LEFT  // Tap: left  | Long-tap: start of line.
#define NAV_RIGHT &mt_end 0    RIGHT // Tap: right | Long-tap: end   of line.
#define NAV_UP    &mt LC(HOME) UP    // Tap: up    | Long-tap: start of doc.
#define NAV_DOWN  &mt LC(END)  DOWN  // Tap: down  | Long-tap: end   of doc.
#define NAV_BSPC  &mt LC(BSPC) BSPC  // Tap: bspc  | Long-tap: delete word bwd.
#define NAV_DEL   &mt LC(DEL)  DEL   // Tap: del   | Long-tap: delete word fwd.

// Mask CTRL on left/right hold to avoid accidental jumps to start/end of doc.
#define MASK_MODS(NAME, MODS, BINDING)                                         \
  ZMK_MOD_MORPH(NAME, bindings = <BINDING>, <BINDING>; mods = <MODS>;)

MASK_MODS(masked_home, (MOD_LCTL), &kp HOME)
MASK_MODS(masked_end,  (MOD_LCTL), &kp END)

/ {
    keymap {
        compatible = "zmk,keymap";

        default_layer {
            display-name = "DEF";
            bindings = <LAYER_FROM38( \
//           ╭──────────────┬──────────────┬──────────────┬──────────────┬──────────────╮   ╭──────────────┬──────────────┬──────────────┬──────────────┬──────────────╮
              &kp Q,         &kp W,         &kp E,         &kp R,         &kp T,             &kp Y,         &kp U,         &kp I,         &kp O,         &kp P, \
              &aml M_PNK A,  &aml M_RNG S,  &aml M_MDL D,  &asl M_IDX F,  &kp G,             &kp H,         &asr M_IDX J,  &amr M_MDL K,  &amr M_RNG L,  &aml M_PNK SQT, \
&kp L_EXP,    &kp Z,         &kp X,         &kp C,         &kp V,         &kp B,             &kp N,         &kp M,         &ht RS(SPACE) COMMA, &mt RALT DOT, &kp SLASH, &kp R_EXP, \
                                            &kp ESC,       &lt NAV SPACE, &lt MSE TAB,       &lt SYM RET,   &lt NUM BSPC,  &kp DEL \
//                                         ╰─────────────┴──────────────┴──────────────╯    ╰──────────────┴──────────────┴──────────────╯
            )>;
        };

        number_layer {
            display-name = "NUM";
            bindings = <LAYER_FROM38( \
//           ╭──────────────┬──────────────┬──────────────┬──────────────┬──────────────╮   ╭──────────────┬──────────────┬──────────────┬──────────────┬──────────────╮
              &kp LBKT,      &kp N7,        &kp N8,        &kp N9,        &kp RBKT,          &kp C_AL_CALC, &uni_mdot,     &none,         &none,         &none, \
              &kp SEMI,      &kp N4,        &kp N5,        &kp N6,        &kp EQUAL,         &to NAV,       &hwp_kg,       &hwp_grm,      &hwp_mg,       &hwp_vac, \
&kp L_EXP,    &kp GRAVE,     &kp N1,        &kp N2,        &kp N3,        &kp BSLH,          &hwp_pm,       &hwp_tmp,      &hwp_won,      &hwp_phi,      &hwp_mm,        &kp R_EXP, \
                                            &kp DOT,       &kp N0,        &kp MINUS,         &trans,        &trans,        &trans \
//                                         ╰──────────────┴──────────────┴──────────────╯   ╰──────────────┴──────────────┴──────────────╯
            )>;
        };

        symbol_layer {
            display-name = "SYM";
            bindings = <LAYER_FROM38( \
//           ╭──────────────┬──────────────┬──────────────┬──────────────┬──────────────╮   ╭──────────────┬──────────────┬──────────────┬──────────────┬──────────────╮
              &kp LBRC,      &kp AMPS,      &kp ASTRK,     &kp LPAR,      &kp RBRC,          &kp PSCRN,     &kp F7,        &kp F8,        &kp F9,        &kp F12, \
              &mt M_PNK COLON, &mt M_RNG DLLR, &mt M_MDL PRCNT, &mt M_IDX CARET, &kp PLUS,   &kp SLCK,      &kp F4,        &kp F5,        &kp F6,        &kp F11, \
&kp L_EXP,    &kp TILDE,     &kp EXCL,      &kp AT,        &kp HASH,      &kp PIPE,          &kp PAUSE_BREAK, &kp F1,      &kp F2,        &kp F3,        &kp F10,       &kp R_EXP, \
                                            &kp LPAR,      &kp RPAR,      &kp UNDER,         &trans,        &trans,        &trans \
//                                         ╰──────────────┴──────────────┴──────────────╯   ╰──────────────┴──────────────┴──────────────╯
            )>;
        };

        navigation_layer {
            display-name = "NAV";
            bindings = <LAYER_FROM38( \
//           ╭──────────────┬──────────────┬──────────────┬──────────────┬──────────────╮   ╭──────────────┬──────────────┬──────────────┬──────────────┬──────────────╮
              &kp W_LFT,     &kp W_RHT,     &kp T_LFT,     &kp T_RHT,     &ht W_CLS T_CLS,   &kp INS,       &kp HOME,      &kp UP,        &kp END,       &kp PG_UP, \
              &kp M_PNK,     &kp M_RNG,     &kp M_MDL,     &kp M_IDX,     &to NUM,           &kp CAPS,      &kp LEFT,      &kp DOWN,      &kp RIGHT,     &kp PG_DN, \
&kp L_EXP,    &kp C_UND,     &kp C_CUT,     &kp C_CPY,     &kp C_PST,     &kp C_RDO,         &kp C_ALL,     &sel_ln,       &sel_wrd,      &kp C_VOL_DN,  &kp C_VOL_UP,  &kp R_EXP, \
                                            &trans,        &trans,        &trans,            &kp RET,       &kp BSPC,      &kp DEL \
//                                         ╰──────────────┴──────────────┴──────────────╯   ╰──────────────┴──────────────┴──────────────╯
            )>;
        };

        mouse_layer {
            display-name = "MSE";
            bindings = <LAYER_FROM38( \
//           ╭──────────────┬──────────────┬──────────────┬──────────────┬──────────────╮   ╭──────────────┬──────────────┬──────────────┬──────────────┬──────────────╮
              &ind_con,      &ind_bat,      &soft_off,     &kp LG(L),     &sleep,            &none,         &msc SCRL_LEFT, &mmv MOVE_UP,  &msc SCRL_RIGHT, &msc SCRL_UP, \
              &kp M_PNK,     &kp M_RNG,     &kp M_MDL,     &kp M_IDX,     &studio_unlock,    &kp K_APP,     &mmv MOVE_LEFT, &mmv MOVE_DOWN, &mmv MOVE_RIGHT, &msc SCRL_DOWN, \
&kp L_EXP,    &bt BT_CLR_ALL, &bt BT_SEL 0, &bt BT_SEL 1,  &bt BT_SEL 2,  &bt BT_CLR,        &kp C_RDO,     &kp C_PST,     &kp C_CPY,     &kp C_CUT,     &kp C_UND,     &kp R_EXP, \
                                            &trans,        &trans,        &trans,            &mkp RCLK,     &mkp LCLK,     &none \
//                                         ╰──────────────┴──────────────┴──────────────╯   ╰──────────────┴──────────────┴──────────────╯
            )>;
        };
        extra1 {
            status = "reserved";
        };
        extra2 {
            status = "reserved";
        };
    };
};
